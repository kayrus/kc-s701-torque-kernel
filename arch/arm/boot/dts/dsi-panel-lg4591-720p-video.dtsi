/*
 * This software is contributed or developed by KYOCERA Corporation.
 * (C) 2014 KYOCERA Corporation
 */
/* Copyright (c) 2013, The Linux Foundation. All rights reserved.
 *
 * This program is free software; you can redistribute it and/or modify
 * it under the terms of the GNU General Public License version 2 and
 * only version 2 as published by the Free Software Foundation.
 *
 * This program is distributed in the hope that it will be useful,
 * but WITHOUT ANY WARRANTY; without even the implied warranty of
 * MERCHANTABILITY or FITNESS FOR A PARTICULAR PURPOSE.  See the
 * GNU General Public License for more details.
 */

/*---------------------------------------------------------------------------
 * This file is autogenerated file using gcdb parser. Please do not edit it.
 * Update input XML file to add a new entry or update variable in this file
 * VERSION = "1.0"
 *---------------------------------------------------------------------------*/
&mdss_mdp {
	dsi_lg4591_720_vid: qcom,mdss_dsi_lg4591_720p_video {
		qcom,mdss-dsi-panel-name = "lg4591 720p video mode dsi panel";
		qcom,mdss-dsi-panel-controller = <&mdss_dsi0>;
		qcom,mdss-dsi-panel-type = "dsi_video_mode";
		qcom,mdss-dsi-panel-destination = "display_1";
		qcom,mdss-dsi-panel-framerate = <60>;
		qcom,mdss-dsi-panel-clockrate = <454528080>;
		qcom,mdss-dsi-virtual-channel-id = <0>;
		qcom,mdss-dsi-stream = <0>;
		qcom,mdss-dsi-panel-width = <720>;
		qcom,mdss-dsi-panel-height = <1280>;
		qcom,mdss-dsi-h-front-porch = <48>;
		qcom,mdss-dsi-h-back-porch = <170>;
		qcom,mdss-dsi-h-pulse-width = <12>;
		qcom,mdss-dsi-h-sync-skew = <0>;
		qcom,mdss-dsi-v-back-porch = <15>;
		qcom,mdss-dsi-v-front-porch = <14>;
		qcom,mdss-dsi-v-pulse-width = <1>;
		qcom,mdss-dsi-h-left-border = <0>;
		qcom,mdss-dsi-h-right-border = <0>;
		qcom,mdss-dsi-v-top-border = <0>;
		qcom,mdss-dsi-v-bottom-border = <0>;
		qcom,mdss-dsi-bpp = <24>;
		qcom,mdss-dsi-underflow-color = <0xff>;
		qcom,mdss-dsi-border-color = <0>;
		qcom,mdss-dsi-on-command_t = [
					15 01 00 00 00 00 02 36 02
					39 01 00 00 00 00 06 E0 43 00 80 00 00
					15 01 00 00 00 00 02 B3 00
					39 01 00 00 00 00 06 B5 59 20 40 00 20
					39 01 00 00 00 00 06 B6 01 40 0F 16 13
					39 01 00 00 00 00 03 C0 00 04
					39 01 00 00 00 00 0A C3 00 09 10 15 00 12 2C 34 02
					39 01 00 00 00 00 06 C4 22 22 1A 1A 4F
					39 01 00 00 00 00 04 C7 10 00 14
					15 01 00 00 00 00 02 C1 00
					15 01 00 00 20 00 02 C2 02
					15 01 00 00 20 00 02 C2 06
					15 01 00 00 20 00 02 C2 4E
					39 01 00 00 00 00 0A D0 00 07 75 65 02 00 70 05 04
					39 01 00 00 00 00 0A D1 00 37 75 65 02 00 72 05 04
					39 01 00 00 00 00 0A D2 00 07 75 65 02 00 70 05 04
					39 01 00 00 00 00 0A D3 00 37 75 65 02 00 72 05 04
					39 01 00 00 00 00 0A D4 00 07 75 65 02 00 70 05 04
					39 01 00 00 10 00 0A D5 00 37 75 65 02 00 72 05 04
					15 01 00 00 00 00 02 70 00
					39 01 00 00 00 00 04 74 01 82 02
					39 01 00 00 1E 00 04 75 02 82 02
					39 01 00 00 1E 00 04 76 05 80 00
					05 01 00 00 80 00 02 11 00
					15 01 00 00 00 00 02 F9 10
					05 01 00 00 10 00 02 29 00
					15 01 00 00 00 00 02 51 39
					15 01 00 00 00 00 02 53 24
					15 01 00 00 00 00 02 55 00
					15 01 00 00 00 00 02 5E 00
					39 01 00 00 00 00 05 C8 82 86 01 11];
		qcom,mdss-dsi-on-command_t_pp = [
					15 01 00 00 00 00 02 36 02
					39 01 00 00 00 00 06 E0 43 00 80 00 00
					15 01 00 00 00 00 02 B3 00
					39 01 00 00 00 00 06 B5 59 20 40 00 20
					39 01 00 00 00 00 06 B6 01 40 0F 16 13
					39 01 00 00 00 00 03 C0 00 04
					39 01 00 00 00 00 0A C3 00 09 10 15 00 12 7C 34 03
					39 01 00 00 00 00 06 C4 22 22 15 15 40
					39 01 00 00 00 00 04 C7 10 00 14
					15 01 00 00 00 00 02 C1 00
					15 01 00 00 20 00 02 C2 02
					15 01 00 00 20 00 02 C2 06
					15 01 00 00 20 00 02 C2 4E
					39 01 00 00 00 00 0A D0 72 67 63 66 02 02 70 17 04
					39 01 00 00 00 00 0A D1 72 67 63 66 02 02 70 17 04
					39 01 00 00 00 00 0A D2 72 67 63 66 02 02 70 17 04
					39 01 00 00 00 00 0A D3 72 67 63 66 02 02 70 17 04
					39 01 00 00 00 00 0A D4 72 67 63 66 02 02 70 17 04
					39 01 00 00 10 00 0A D5 72 67 63 66 02 02 70 17 04
					15 01 00 00 00 00 02 70 00
					39 01 00 00 00 00 04 74 01 82 02
					39 01 00 00 1E 00 04 75 02 82 02
					39 01 00 00 1E 00 04 76 05 80 00
					05 01 00 00 80 00 02 11 00
					15 01 00 00 00 00 02 F9 40
					05 01 00 00 10 00 02 29 00
					15 01 00 00 00 00 02 51 39
					15 01 00 00 00 00 02 53 24
					15 01 00 00 00 00 02 55 00
					15 01 00 00 00 00 02 5E 00
					39 01 00 00 00 00 05 C8 82 86 01 11];
		qcom,mdss-dsi-on-command_g = [
					15 01 00 00 00 00 02 36 02
					39 01 00 00 00 00 06 E0 43 00 80 00 00
					15 01 00 00 00 00 02 B3 00
					39 01 00 00 00 00 06 B5 59 20 40 00 20
					39 01 00 00 00 00 06 B6 01 40 0F 16 13
					39 01 00 00 00 00 0A D0 00 34 75 64 02 00 70 05 04
					39 01 00 00 00 00 0A D1 00 34 75 64 02 00 70 05 04
					39 01 00 00 00 00 0A D2 00 34 75 64 02 00 70 05 04
					39 01 00 00 00 00 0A D3 00 34 75 64 02 00 70 05 04
					39 01 00 00 00 00 0A D4 00 34 75 64 02 00 70 05 04
					39 01 00 00 00 00 0A D5 00 34 75 64 02 00 70 05 04
					39 01 00 00 00 00 03 C0 00 04
					39 01 00 00 00 00 0A C3 00 09 10 15 00 12 2C 33 02
					39 01 00 00 00 00 06 C4 22 24 15 15 52
					39 01 00 00 00 00 04 C7 10 00 14
					15 01 00 00 00 00 02 F9 10
					15 01 00 00 00 00 02 C1 00
					15 01 00 00 2D 00 02 C2 02
					15 01 00 00 2D 00 02 C2 06
					15 01 00 00 2D 00 02 C2 4E
					05 01 00 00 2D 00 02 11 00
					15 01 00 00 1E 00 02 F9 40
					15 01 00 00 00 00 02 70 00
					39 01 00 00 00 00 04 74 01 82 02
					39 01 00 00 1E 00 04 75 02 82 02
					05 01 00 00 1E 00 02 29 00
					15 01 00 00 00 00 02 53 24
					15 01 00 00 00 00 02 55 00
					15 01 00 00 00 00 02 5E 00
					39 01 00 00 00 00 05 C8 82 86 01 11
					15 01 00 00 00 00 02 51 39];
		qcom,mdss-dsi-on-command_refresh_t = [
					15 01 00 00 00 00 02 36 02
					39 01 00 00 00 00 06 E0 43 00 80 00 00
					15 01 00 00 00 00 02 B3 00
					39 01 00 00 00 00 06 B5 59 20 40 00 20
					39 01 00 00 00 00 06 B6 01 40 0F 16 13
					39 01 00 00 00 00 03 C0 00 04
					39 01 00 00 00 00 0A C3 00 09 10 15 00 12 2C 34 02
					39 01 00 00 00 00 06 C4 22 22 1A 1A 4F
					39 01 00 00 00 00 04 C7 10 00 14
					15 01 00 00 00 00 02 C1 00
					15 01 00 00 20 00 02 C2 02
					15 01 00 00 20 00 02 C2 06
					15 01 00 00 20 00 02 C2 4E
					39 01 00 00 00 00 0A D0 00 07 75 65 02 00 70 05 04
					39 01 00 00 00 00 0A D1 00 37 75 65 02 00 72 05 04
					39 01 00 00 00 00 0A D2 00 07 75 65 02 00 70 05 04
					39 01 00 00 00 00 0A D3 00 37 75 65 02 00 72 05 04
					39 01 00 00 00 00 0A D4 00 07 75 65 02 00 70 05 04
					39 01 00 00 10 00 0A D5 00 37 75 65 02 00 72 05 04
					15 01 00 00 00 00 02 70 00
					39 01 00 00 00 00 04 74 01 82 02
					39 01 00 00 1E 00 04 75 02 82 02
					39 01 00 00 1E 00 04 76 05 80 00
					05 01 00 00 80 00 02 11 00
					15 01 00 00 00 00 02 F9 10
					05 01 00 00 10 00 02 29 00
					15 01 00 00 00 00 02 51 39
					15 01 00 00 00 00 02 53 24
					15 01 00 00 00 00 02 55 00
					15 01 00 00 00 00 02 5E 00
					39 01 00 00 00 00 05 C8 82 86 01 11];
		qcom,mdss-dsi-on-command_refresh_t_pp = [
					15 01 00 00 00 00 02 36 02
					39 01 00 00 00 00 06 E0 43 00 80 00 00
					15 01 00 00 00 00 02 B3 00
					39 01 00 00 00 00 06 B5 59 20 40 00 20
					39 01 00 00 00 00 06 B6 01 40 0F 16 13
					39 01 00 00 00 00 03 C0 00 04
					39 01 00 00 00 00 0A C3 00 09 10 15 00 12 7C 34 03
					39 01 00 00 00 00 06 C4 22 22 15 15 40
					39 01 00 00 00 00 04 C7 10 00 14
					15 01 00 00 00 00 02 C1 00
					15 01 00 00 20 00 02 C2 02
					15 01 00 00 20 00 02 C2 06
					15 01 00 00 20 00 02 C2 4E
					39 01 00 00 00 00 0A D0 72 67 63 66 02 02 70 17 04
					39 01 00 00 00 00 0A D1 72 67 63 66 02 02 70 17 04
					39 01 00 00 00 00 0A D2 72 67 63 66 02 02 70 17 04
					39 01 00 00 00 00 0A D3 72 67 63 66 02 02 70 17 04
					39 01 00 00 00 00 0A D4 72 67 63 66 02 02 70 17 04
					39 01 00 00 10 00 0A D5 72 67 63 66 02 02 70 17 04
					15 01 00 00 00 00 02 70 00
					39 01 00 00 00 00 04 74 01 82 02
					39 01 00 00 1E 00 04 75 02 82 02
					39 01 00 00 1E 00 04 76 05 80 00
					05 01 00 00 80 00 02 11 00
					15 01 00 00 00 00 02 F9 40
					05 01 00 00 10 00 02 29 00
					15 01 00 00 00 00 02 51 39
					15 01 00 00 00 00 02 53 24
					15 01 00 00 00 00 02 55 00
					15 01 00 00 00 00 02 5E 00
					39 01 00 00 00 00 05 C8 82 86 01 11];
		qcom,mdss-dsi-on-command_refresh_g = [
					15 01 00 00 00 00 02 36 02
					39 01 00 00 00 00 06 E0 43 00 80 00 00
					15 01 00 00 00 00 02 B3 00
					39 01 00 00 00 00 06 B5 59 20 40 00 20
					39 01 00 00 00 00 06 B6 01 40 0F 16 13
					39 01 00 00 00 00 0A D0 10 01 52 46 01 06 70 45 04
					39 01 00 00 00 00 0A D1 10 01 52 46 01 06 70 45 04
					39 01 00 00 00 00 0A D2 10 01 52 46 01 06 70 45 04
					39 01 00 00 00 00 0A D3 10 01 52 46 01 06 70 45 04
					39 01 00 00 00 00 0A D4 10 01 52 46 01 06 70 45 04
					39 01 00 00 00 00 0A D5 10 01 52 46 01 06 70 45 04
					39 01 00 00 00 00 03 C0 00 04
					39 01 00 00 00 00 0A C3 00 09 10 15 00 12 2C 33 02
					39 01 00 00 00 00 06 C4 22 24 15 15 52
					39 01 00 00 00 00 04 C7 10 00 14
					15 01 00 00 00 00 02 F9 10
					15 01 00 00 00 00 02 C1 00
					15 01 00 00 2D 00 02 C2 02
					15 01 00 00 2D 00 02 C2 06
					15 01 00 00 2D 00 02 C2 4E
					05 01 00 00 96 00 02 11 00
					05 01 00 00 1E 00 02 29 00
					15 01 00 00 00 00 02 53 24
					15 01 00 00 00 00 02 55 00
					15 01 00 00 00 00 02 5E 00
					39 01 00 00 00 00 05 C8 82 86 01 11
					15 01 00 00 00 00 02 51 39];
		qcom,mdss-dsi-off-command_t = [
					15 01 00 00 00 00 02 51 00
					15 01 00 00 00 00 02 53 00
					05 01 00 00 40 00 02 28 00
					05 01 00 00 80 00 02 10 00];

		qcom,mdss-dsi-off-command_g = [
					15 01 00 00 00 00 02 51 00
					15 01 00 00 1E 00 02 53 00
					05 01 00 00 3C 00 02 28 00
					05 01 00 00 0A 00 02 10 00
					15 01 00 00 00 00 02 C1 01];
		qcom,mdss-dsi-on-command-state = "dsi_lp_mode";
		qcom,mdss-dsi-off-command-state = "dsi_hs_mode";
		qcom,mdss-dsi-h-sync-pulse = <1>;
		qcom,mdss-dsi-traffic-mode = "non_burst_sync_pulse";
		qcom,mdss-dsi-lane-map = "lane_map_0123";
		qcom,mdss-dsi-bllp-eof-power-mode;
		qcom,mdss-dsi-bllp-power-mode;
		qcom,mdss-dsi-force-clk-hs;
		qcom,mdss-dsi-lane-0-state;
		qcom,mdss-dsi-lane-1-state;
		qcom,mdss-dsi-lane-2-state;
		qcom,mdss-dsi-lane-3-state;
		qcom,mdss-dsi-panel-timings = [97 18 10 00 52 54 14 28 29 03 04 00];
		qcom,mdss-dsi-t-clk-post = <0x08>;
		qcom,mdss-dsi-t-clk-pre = <0x23>;
		qcom,mdss-dsi-bl-min-level = <1>;
		qcom,mdss-dsi-bl-max-level = <255>;
		qcom,mdss-dsi-dma-trigger = "trigger_sw";
		qcom,mdss-dsi-mdp-trigger = "none";
		qcom,mdss-dsi-bl-pmic-control-type = "bl_ctrl_dcs";
		qcom,mdss-dsi-reset-sequence = <1 20>, <0 1>, <1 20>;
		qcom,mdss-pan-physical-width-dimension = <56>;
		qcom,mdss-pan-physical-height-dimension = <99>;

	};
};
